## CMakeLists.txt
```
cmake_minimum_required(VERSION 3.20.0)
find_package(Zephyr REQUIRED HINTS $ENV{ZEPHYR_BASE})
project(idle)
target_sources(app PRIVATE src/main.c)
```

## prj.conf
```kconfig
# Idle firmware: CPU sleeps forever and never touches GPIO, so the debugger
# (nrfjprog --memwr) can own the GPIO registers for LED/pin identification.
CONFIG_GPIO=n
CONFIG_SERIAL=n
CONFIG_CONSOLE=n
CONFIG_UART_CONSOLE=n
CONFIG_I2C=n
CONFIG_SPI=n
```

## src/main.c
```c
/* Idle firmware — does nothing, so the J-Link debugger owns the GPIO registers.
 * Used for LED/pin identification by driving pins via nrfjprog --memwr. */
#include <zephyr/kernel.h>

int main(void)
{
	while (1) {
		k_sleep(K_SECONDS(3600));
	}
	return 0;
}
```
